## CMakeLists.txt
```
#
# Copyright (c) 2023 Nordic Semiconductor ASA
#
# SPDX-License-Identifier: LicenseRef-Nordic-5-Clause
#
cmake_minimum_required(VERSION 3.20.0)

find_package(Zephyr REQUIRED HINTS $ENV{ZEPHYR_BASE})

project(openthread_csl)

target_sources(app PRIVATE src/main.c)

target_sources_ifdef(CONFIG_BOARD_NRF52_BSIM app PRIVATE
	src/csl_test.c
	src/test_main.c
)

zephyr_include_directories(
  ${BSIM_COMPONENTS_PATH}/libUtilv1/src/
  ${BSIM_COMPONENTS_PATH}/libPhyComv1/src/
  )
```

## Kconfig
```
# Copyright (c) 2023 Nordic Semiconductor ASA
# SPDX-License-Identifier: LicenseRef-Nordic-5-Clause

menu "Zephyr Kernel"
source "Kconfig.zephyr"
endmenu
```

## prj.conf
```kconfig
#
# Copyright (c) 2023 Nordic Semiconductor
#
# SPDX-License-Identifier: LicenseRef-Nordic-5-Clause
#

CONFIG_NETWORKING=y

CONFIG_NET_L2_OPENTHREAD=y
CONFIG_OPENTHREAD_NETWORKKEY="00:11:22:33:44:55:66:77:88:99:aa:bb:cc:dd:ee:ff"
CONFIG_OPENTHREAD_THREAD_VERSION_1_3_1=y
# CONFIG_OPENTHREAD_CSL_TRANSMITTER=y
CONFIG_OPENTHREAD_CSL_RECEIVER=y
CONFIG_OPENTHREAD_RADIO_STATS=y
CONFIG_NRF_802154_ENCRYPTION=y

CONFIG_MAIN_STACK_SIZE=2048

CONFIG_LOG=y

CONFIG_NRF_802154_SOURCE_INTERNAL=y
```

## src/main.c
```c
#include <zephyr/kernel.h>
#include <zephyr/net/openthread.h>
#include <openthread/thread.h>
#include <openthread/radio_stats.h>

#include <zephyr/logging/log.h>
LOG_MODULE_REGISTER(csl_tst, LOG_LEVEL_INF);

#define POLL_PERIOD 1000

uint8_t conf_role = 0; /* 0 = Leader, 1 = SED, 2 = SSED */
uint8_t conf_accuracy;
uint8_t conf_uncert;

uint32_t result_total_time_ms;
uint32_t result_disabled_time_ms;
uint32_t result_sleep_time_ms;
uint32_t result_rx_time_ms;
uint32_t result_tx_time_ms;

static struct openthread_context *context;

void start_stats(void)
{
    otRadioTimeStatsReset(context->instance);
}

void gather_stats(void)
{
    const otRadioTimeStats *radioStats = otRadioTimeStatsGet(context->instance);

    result_total_time_ms = (radioStats->mDisabledTime + radioStats->mSleepTime + radioStats->mTxTime + radioStats->mRxTime) / 1000;
    result_disabled_time_ms = radioStats->mDisabledTime/1000;
    result_sleep_time_ms = radioStats->mSleepTime/1000;
    result_rx_time_ms = radioStats->mRxTime/1000;
    result_tx_time_ms = radioStats->mTxTime/1000;
}

int main(void)
{
    context = openthread_get_default_context();

    LOG_INF("conf_role=%u, conf_accuracy=%u, conf_uncert=%u", conf_role, conf_accuracy, conf_uncert);

    if (conf_role != 0)
    {
        otLinkModeConfig linkMode;

        linkMode.mRxOnWhenIdle = false;
        linkMode.mDeviceType = false;
        linkMode.mNetworkData = false;
        otThreadSetLinkMode(context->instance, linkMode);
    }

    if (conf_role == 1)
    {
        otLinkSetPollPeriod(context->instance, POLL_PERIOD);
    }

    if (conf_role == 2)
    {
        otLinkSetCslPeriod(context->instance, POLL_PERIOD*1000);
    }

	openthread_start(context);

    return 0;
}
```

## src/csl_test.c
```c
/*
 * Copyright (c) 2023 Nordic Semiconductor ASA
 *
 * SPDX-License-Identifier: Apache-2.0
 */

#include "bs_types.h"
#include "bs_tracing.h"
#include "bs_utils.h"
#include "time_machine.h"
#include "bstests.h"

#include <zephyr/kernel.h>
#include <openthread/radio_stats.h>

#define START_TIME 15 /* Seconds */
#define MEASURE_TIME 100 /* Seconds */

static bool stats_started = false;

extern enum bst_result_t bst_result;

extern uint8_t conf_role;
extern uint8_t conf_accuracy;
extern uint8_t conf_uncert;

extern uint32_t result_total_time_ms;
extern uint32_t result_disabled_time_ms;
extern uint32_t result_sleep_time_ms;
extern uint32_t result_rx_time_ms;
extern uint32_t result_tx_time_ms;

#define FAIL(...)					\
	do {						\
		bst_result = Failed;			\
		bs_trace_error_time_line(__VA_ARGS__);	\
	} while (0)

#define PASS(...)					\
	do {						\
		bst_result = Passed;			\
		bs_trace_info_time(1, __VA_ARGS__);	\
	} while (0)

static void test_csl_init(void)
{
	bs_trace_info_time(1, "role: %u\n", conf_role);

	if (conf_role == 0)
	{
		PASS("Parent test passed.\n");
	}
	else
	{
		bs_trace_info_time(1, "next event: %u s\n", START_TIME);
		bst_ticker_set_next_tick_absolute(START_TIME*1e6);
		bst_result = In_progress;
	}
}

static void test_csl_tick(bs_time_t HW_device_time)
{
	extern void start_stats(void);
	extern void gather_stats(void);

	if (!stats_started)
	{

		start_stats();
		stats_started = true;
		bs_trace_info_time(1, "next event: %u s\n", MEASURE_TIME);
		bst_ticker_set_next_tick_delta(MEASURE_TIME*1e6);
	}
	else
	{
		gather_stats();
		bs_trace_info_time(1, "Total time: %lu ms\n", result_total_time_ms);
		bs_trace_info_time(1, "Disabled time: %lu ms\n", result_disabled_time_ms);
		bs_trace_info_time(1, "Sleep time: %lu ms\n", result_sleep_time_ms);
		bs_trace_info_time(1, "Rx time: %lu ms\n", result_rx_time_ms);
		bs_trace_info_time(1, "Tx time: %lu ms\n", result_tx_time_ms);

		PASS("Child test passed.\n");
		bs_trace_exit("Done, disconnecting from simulation\n");
	}
}

void test_args(int argc, char **argv)
{
	conf_role = atol(argv[0]);

	if (argc == 3)
	{
		conf_accuracy = atol(argv[1]);
		conf_uncert = atol(argv[2]);
	}
}

static const struct bst_test_instance test_def[] = {
	{
		.test_id = "parent",
		.test_descr = "CSL Transmitter role",
		.test_post_init_f = test_csl_init,
		.test_args_f = test_args,
	},
	{
		.test_id = "child",
		.test_descr = "SED/SSED role",
		.test_post_init_f = test_csl_init,
		.test_tick_f = test_csl_tick,
		.test_args_f = test_args,
	},
	BSTEST_END_MARKER,
};

struct bst_test_list *test_csl_install(struct bst_test_list *tests)
{
	return bst_add_tests(tests, test_def);
}
```

## src/test_main.c
```c
/*
 * Copyright (c) 2023 Nordic Semiconductor ASA
 *
 * SPDX-License-Identifier: Apache-2.0
 */

#include "bstests.h"

extern struct bst_test_list *test_csl_install(struct bst_test_list *tests);

bst_test_install_t test_installers[] = {
	test_csl_install,
	NULL
};
```
